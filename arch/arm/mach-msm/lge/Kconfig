## arch/arm/mach-msm/lge/Kconfig
```kconfig
config MACH_LGE
	bool

menu "LGE Board Selection"

config MACH_MSM8974_G3_KR
	depends on ARCH_MSM8974
	select MACH_LGE
	bool "MSM8974 G3 KR"
	help
	  Support for the Qualcomm MSM8974 G3 KR device.

config MACH_MSM8974_G3_LGU
	depends on ARCH_MSM8974
	select MACH_LGE
	bool "MSM8974 G3 LGU"
	help
	  Support for the Qualcomm MSM8974 G3 LG Uplus device.

config MACH_MSM8974_G3_LGU_EVB
	depends on ARCH_MSM8974
	select MACH_LGE
	bool "MSM8974 G3 LGU EVB"
	help
	  Support for the Qualcomm MSM8974 G3 LG Uplus EVB device.

config MACH_MSM8974_G3_SKT
	depends on ARCH_MSM8974
	select MACH_LGE
	bool "MSM8974 G3 SKT"
	help
	  Support for the Qualcomm MSM8974 G3 SKT device.

config MACH_MSM8974_G3_KT
	depends on ARCH_MSM8974
	select MACH_LGE
	bool "MSM8974 G3 KT"
	help
	  Support for the Qualcomm MSM8974 G3 KT device.

config MACH_MSM8974_G3_VZW
	depends on ARCH_MSM8974
	select MACH_LGE
	bool "MSM8974 G3 VZW"
	help
	  Support for the Qualcomm MSM8974 G3 Verizon device.

config MACH_MSM8974_G3_LRA
	depends on ARCH_MSM8974
	select MACH_LGE
	bool "MSM8974 G3 LRA"
	help
	  Support for the Qualcomm MSM8974 G3 LRA device.

config MACH_MSM8974_G3_ATT
	depends on ARCH_MSM8974
	select MACH_LGE
	bool "MSM8974 G3 ATT"
	help
	  Support for the Qualcomm MSM8974 G3 AT&T device.

config MACH_MSM8974_G3_SPR_US
	depends on ARCH_MSM8974
	select MACH_LGE
	bool "MSM8974 G3 SPR US"
	help
	  Support for the Qualcomm MSM8974 G3 Sprint device.

config MACH_MSM8974_G3_USC_US
	depends on ARCH_MSM8974
	select MACH_LGE
	bool "MSM8974 G3 USC US"
	help
	  Support for the Qualcomm MSM8974 G3 Usc device.

config MACH_MSM8974_G3_TMO_US
	depends on ARCH_MSM8974
	select MACH_LGE
	bool "MSM8974 G3 TMO US"
	help
	  Support for the Qualcomm MSM8974 G3 AT&T device.

config MACH_MSM8974_G3_CN
	depends on ARCH_MSM8974
	select MACH_LGE
	bool "MSM8974 G3 CN"
	help
	  Support for the Qualcomm MSM8974 G3 CHINA device.
	  
config MACH_MSM8974_G3_CMCC_CN
	depends on ARCH_MSM8974
	select MACH_LGE
	bool "MSM8974 G3 CMCC CN"
	help
	  Support for the Qualcomm MSM8974 G3 CMCC device.

config MACH_MSM8974_G3_CTC_CN
	depends on ARCH_MSM8974
	select MACH_LGE
	bool "MSM8974 G3 CTC CN"
	help
	  Support for the Qualcomm MSM8974 G3 CTC device.

config MACH_MSM8974_G3_CUCC_CN
	depends on ARCH_MSM8974
	select MACH_LGE
	bool "MSM8974 G3 CUCC CN"
	help
	  Support for the Qualcomm MSM8974 G3 CUCC device.
	  
config MACH_MSM8974_G3_KDDI
	depends on ARCH_MSM8974
	select MACH_LGE
	bool "MSM8974 G3 KDDI"
	help
	  Support for the Qualcomm MSM8974 G3 KDDI device.

config MACH_MSM8974_G3_KDDI_EVB
	depends on ARCH_MSM8974
	select MACH_LGE
	bool "MSM8974 G3 KDDI EVB"
	help
	  Support for the Qualcomm MSM8974 G3 LG KDDI EVB device.

config MACH_MSM8974_G3_GLOBAL_COM
	depends on ARCH_MSM8974
	select MACH_LGE
	bool "MSM8974 G3 GLOBAL COM"
	help
	  Support for the Qualcomm MSM8974 G3 GLOBAL device.

config MACH_MSM8974_G3_CA
	depends on ARCH_MSM8974
	select MACH_LGE
	bool "MSM8974 G3 CA"
	help
	  Support for the Qualcomm MSM8974 G3 Canada device.

config MACH_MSM8974_G3_BELL
	depends on ARCH_MSM8974
	select MACH_LGE
	bool "MSM8974 G3 BELL"
	help
	  Support for the Qualcomm MSM8974 G3 BELL device.

config MACH_MSM8974_G3_TLS
	depends on ARCH_MSM8974
	select MACH_LGE
	bool "MSM8974 G3 TLS"
	help
	  Support for the Qualcomm MSM8974 G3 TLS device.

config MACH_MSM8974_G3_RGS
	depends on ARCH_MSM8974
	select MACH_LGE
	bool "MSM8974 G3 RGS"
	help
	  Support for the Qualcomm MSM8974 G3 RGS device.

config MACH_MSM8974_G3_VTR
	depends on ARCH_MSM8974
	select MACH_LGE
	bool "MSM8974 G3 VTR"
	help
	  Support for the Qualcomm MSM8974 G3 VTR device.
	  
config MACH_MSM8974_G3_WIN
	depends on ARCH_MSM8974
	select MACH_LGE
	bool "MSM8974 G3 WIN"
	help
	  Support for the Qualcomm MSM8974 G3 WIN device.

menuconfig LGE_SPECIFIC_PATCHES
    depends on MACH_LGE
    bool "LGE Specific Patches"

config DTS_TARGET
	string "DTS target dir"
	help
	  CONFIG_DTS_TARGET should be set to support appended dts.
	  ex) CONFIG_DTS_TARGET="msm8974-g3".

config LGE_HANDLE_PANIC
    tristate "Support LGE Kernel Panic Handler"
    default n
    depends on MACH_LGE
    help
      LGE Error handler

config LGE_BOOTLOADER_LOG
	tristate "Support LGE bootloader log"
	default n
	depends on MACH_LGE
	help
	  LGE bootloader log

config LGE_LCD_TUNING
	bool "lcd_gamma_tuning"
	default n
	depends on MACH_LGE
	help
	  Support LCD gamma tuning.

config LGE_PSEUDO_CHG_UI
	bool "Support pseudo charging UI"
	default n
	depends on MACH_LGE
	help
	  LGE PSEUDO CHG UI.

config LGE_BOOTLOADER_TIME_CHECKER
	bool "Show bootloader(LK, SBL) time"
	default n
	depends on MACH_LGE
	help
	  This shows the lk and sbl1 booting time in MSM8974.
	  If this feature is enabled, it should be check by adb shell.
	  Device Node : sys/module/lge_bootloader_time_checker/

config LGE_USES_SMD_DS_TTY
    bool "Explicitly use smd tty driver for DS"
	default n
	depends on MSM_SMD_TTY && MACH_LGE
	help
	  In Qualcomm MSM89xx, smd tty driver for ds(/dev/smd0) is not used.
	  Say yes if this tty driver must be used on LGE device. This is used
	  to connect smd channel in user space(for example, ATCMD processing).

config LGE_KSWITCH
    tristate "Support LGE Kill Switch"
    default n
    depends on MACH_LGE
    help
      LGE Kill Switch

config LCD_KCAL
	depends on MACH_LGE
	bool "Enable sysfs for LCD KCAL"
	default n

config LGE_QSDL_SUPPORT
    tristate "Support for Quality Statistics Data Logging"
    default n
    depends on MACH_LGE
    help
       QSDL is a feature which notify infomation for quality statistics
       data logging of device.

config LGE_QFPROM_INTERFACE
	bool "Support qfprom interface"
	default n
	depends on MACH_LGE
	help
	  LGE QFPROM DRIVER.

endmenu
```

## drivers/broadcast/Kconfig
```kconfig
# LGE Broadcast Device Driver Support

menu "LGE Broadcast Device Support"


# config LGE_BROADCAST_ONESEG
#	bool "1Seg Broadcast service"
#	depends on (MACH_MSM8960_L_DCM)||(MACH_MSM8974_G2_DCM)||(MACH_MSM8974_G2_KDDI) || (MACH_MSM8974_Z_KDDI)
#	default y
#	help
#	  Select this if you want to use Japanese 1Seg mobile broadcast service

config LGE_BROADCAST_JFULLSEG
	bool "Japan full-seg Broadcast service"
	depends on (MACH_MSM8974_Z_KDDI) || (MACH_MSM8974_G3_KDDI_EVB) || (MACH_MSM8974_G3_KDDI)
	default y
	help
	  Select this if you want to use Japanese FullSeg mobile broadcast service

config LGE_BROADCAST_TDMB
	bool "LGE broadcast TDMB device Driver"
	depends on (MACH_MSM8974_G3_KR)
	default y
	help
	  Select this if you want to use TDMB broadcast service

source "drivers/broadcast/oneseg/Kconfig"
source "drivers/broadcast/tdmb/Kconfig"
endmenu
```
